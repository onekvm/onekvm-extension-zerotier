## oe-recipes/meta-onekvm-extension-zerotier/conf/layer.conf
```bitbake
BBPATH .= ":${LAYERDIR}"
BBFILES += "${LAYERDIR}/recipes-*/*/*.bb ${LAYERDIR}/recipes-*/*/*.bbappend"
BBFILE_COLLECTIONS += "onekvm-extension-zerotier"
BBFILE_PATTERN_onekvm-extension-zerotier := "^${LAYERDIR}/"
BBFILE_PRIORITY_onekvm-extension-zerotier = "8"
LAYERDEPENDS_onekvm-extension-zerotier = "core onekvm"
LAYERSERIES_COMPAT_onekvm-extension-zerotier = "wrynose"
```
